/*
 * Top level DTS file for CVM:P3767-0000 and CVB:antmicro-job.
 *
 * Copyright (c) 2021-2022, NVIDIA CORPORATION.  All rights reserved.
 * Copyright (c) 2023 Antmicro <www.antmicro.com>
 *
 * This program is free software; you can redistribute it and/or modify
 * it under the terms of the GNU General Public License as published by
 * the Free Software Foundation; version 2 of the License.
 *
 * This program is distributed in the hope that it will be useful, but WITHOUT
 * ANY WARRANTY; without even the implied warranty of MERCHANTABILITY or
 * FITNESS FOR A PARTICULAR PURPOSE.  See the GNU General Public License for
 * more details.
 */

/dts-v1/;
#include "tegra234-p3768-0000+p3767-0000.dts"
#include "nv-platform/tegra234-p3768-0000+p3767-xxxx-nv-common.dtsi"
#include "tegra234-antmicro-job.dtsi"

/* 1xIMX219 cameras */
#include "tegra234-antmicro-job-camera-imx219.dtsi"

/ {
	nvidia,dtsfilename = __FILE__;
	nvidia,dtbbuildtime = __DATE__, __TIME__;
	compatible = "antmicro,job+p3767-0000", "nvidia,p3767-0000", "nvidia,tegra234", "nvidia,tegra23x";
	model = "NVIDIA Orin NX SoM on Antmicro Jetson Orin Baseboard";
};
