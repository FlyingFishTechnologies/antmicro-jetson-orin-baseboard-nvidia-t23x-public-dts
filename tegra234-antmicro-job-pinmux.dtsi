/*
 * Copyright (c) 2025 Antmicro <www.antmicro.com>
 *
 * This program is free software; you can redistribute it and/or modify
 * it under the terms of the GNU General Public License as published by
 * the Free Software Foundation; version 2 of the License.
 *
 * This program is distributed in the hope that it will be useful, but WITHOUT
 * ANY WARRANTY; without even the implied warranty of MERCHANTABILITY or
 * FITNESS FOR A PARTICULAR PURPOSE.  See the GNU General Public License for
 * more details.
 */

#include <dt-bindings/pinctrl/pinctrl-tegra.h>

&pinmux_aon {
	pinctrl-names = "default";
	pinctrl-0 = <&jetson_io_pinmux_aon>;

	jetson_io_pinmux_aon: exp-header-pinmux {
		pin128 {
			nvidia,pins = "spi2_mosi_pcc2";
			nvidia,pin-label = "gpio05";
			nvidia,pull = <TEGRA_PIN_PULL_NONE>;
			nvidia,tristate = <TEGRA_PIN_ENABLE>;
			nvidia,enable-input = <TEGRA_PIN_ENABLE>;
		};

		pin130 {
			nvidia,pins = "spi2_cs0_pcc3";
			nvidia,pin-label = "gpio06";
			nvidia,pull = <TEGRA_PIN_PULL_NONE>;
			nvidia,tristate = <TEGRA_PIN_ENABLE>;
			nvidia,enable-input = <TEGRA_PIN_ENABLE>;
		};
	};
};
